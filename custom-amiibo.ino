#include <SPI.h>
#include <MFRC522.h>

// RST and SS Pins
#define RST_PIN 9
#define SS_PIN 10

// Create an MFRC522 instance
MFRC522 mfrc522(SS_PIN, RST_PIN);

void setup() {

    Serial.begin(9600);                 // Initialize serial communications with the PC
    SPI.begin();                        // Init SPI bus

    mfrc522.PCD_Init();                 // Init MFRC522 card
    mfrc522.PCD_DumpVersionToSerial();  // Show details of PCD - MFRC522 Card Reader details
    Serial.println(F("Arduino Amiibo writer. Put your NFC-tag to the reader"));

}

void loop() {

    // Look for new cards
    if (!mfrc522.PICC_IsNewCardPresent()) return;

    // Select one of the cards
    if (!mfrc522.PICC_ReadCardSerial()) return;

    // Permitted write blocks on MIFARE 1K
    int blocks[] = {1,2,4,5,6,8,9,10,12,13,14,16,17,18,20,21,22,24,25,26,28,29,30,32,33,34,36,37,38,40,41,42,44,45};

    // Custom data
    byte dataBlock[] = { 0x00,0x00,0x00,0x88,0x34,0xe2,0x43,0x03,0x96,0x48,0x00,0x00,0xf1,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0x00,0x00 };

    // Initializing MIFARE PICC default key (FF FF FF FF FF FF)
    MFRC522::MIFARE_Key key;
    for (byte i = 0; i < 6; i++) key.keyByte[i] = 0xFF;

    // Current tag status
    MFRC522::StatusCode status;

    // Displaying PICC properties to serial
    Serial.print(F("Card UID:"));
    for (byte i = 0; i < mfrc522.uid.size; i++) {

        Serial.print(mfrc522.uid.uidByte[i] < 0x10 ? " 0" : " ");
        Serial.print(mfrc522.uid.uidByte[i], HEX);

    }

    Serial.print(F("\nPICC type: "));
    MFRC522::PICC_Type piccType = mfrc522.PICC_GetType(mfrc522.uid.sak);
    Serial.println(mfrc522.PICC_GetTypeName(piccType));

    // Writing main data
    for (int i = 0; i < 34; i++) {

        // Debugging into serial
        Serial.print(F("Writing data into block ")); Serial.print(blocks[i]); Serial.println(F(" ..."));
        dump_byte_array(dataBlock + (i * 16), 16); Serial.println();

        // Authenticating
        status = mfrc522.PCD_Authenticate(MFRC522::PICC_CMD_MF_AUTH_KEY_A, blocks[i], &key, &(mfrc522.uid));
        if (status != MFRC522::STATUS_OK) {

            Serial.print(F("PCD_Authenticate() failed: "));
            Serial.println(mfrc522.GetStatusCodeName(status));
            return;

        }
        else Serial.println(F("PCD_Authenticate() success: "));

        // Writing data to block
        status = (MFRC522::StatusCode) mfrc522.MIFARE_Write(blocks[i], dataBlock + (i * 16), 16);

        if (status != MFRC522::STATUS_OK) {

            Serial.print(F("MIFARE_Write() failed: "));
            Serial.println(mfrc522.GetStatusCodeName(status));
            return;

        }
        else Serial.println(F("MIFARE_Write() success: "));

    }

    mfrc522.PICC_HaltA();       // Halt PICC
    mfrc522.PCD_StopCrypto1();  // Stop encryption on PCD

}

// Helper routine to dump a byte array as hex values to Serial
void dump_byte_array(byte *buffer, byte bufferSize) {

    for (byte i = 0; i < bufferSize; i++) {

        Serial.print(buffer[i] < 0x10 ? " 0" : " ");
        Serial.print(buffer[i], HEX);

    }

}